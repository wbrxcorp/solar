#include <Wire.h>
#include "display.h"

static uint8_t buffer[DISPLAY_WIDTH * DISPLAY_HEIGHT / 8] = {
  0x00,0x00,0x00,0x00,0x00,0x00,0x00,0x00,0x00,0x00,0x00,0x00,0x00,0x00,0x00,0x00,
  0x00,0x00,0x00,0x00,0x00,0x00,0x00,0x00,0x00,0x00,0x00,0x00,0x00,0x00,0x00,0x00,
  0x00,0x00,0x00,0x00,0x00,0x00,0x00,0x00,0x00,0x00,0x00,0x00,0x00,0x00,0x00,0x00,
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  0x00,0x00,0x00,0x00,0x00,0x00,0x00,0x00,0x00,0x00,0x00,0x00,0x00,0x00,0x00,0x00
};

void Display::drawPixel(int16_t x, int16_t y, uint16_t color) {
  if ((x < 0) || (x >= DISPLAY_WIDTH) || (y < 0) || (y >= DISPLAY_HEIGHT)) return;
  // else
  // assumes rotation is 0
  uint8_t& b = buffer[x + (y / 8) * DISPLAY_WIDTH];
  if (color > 0) {
    b |= 1 << (y & 7); // set pixel
  } else {
    b &= ~(1 << (y & 7)); // reset pixel
  }
}

/*
static void dump_buffer()
{
  for (int i = 0; i < 64; i++) {
    printf("  ");
    for (int j = 0; j < 16; j++) {
      printf("0x%02x, ", buffer[i*16+j]);
    }
    printf("\n");
}
*/

static void send_commands(uint8_t i2caddr, const uint8_t commands[], uint8_t count)
{
  for (int i = 0; i < count; i++) {
    Wire.beginTransmission(i2caddr);
    Wire.write(0x00/*control*/);
    Wire.write(commands[i]);
    Wire.endTransmission();
  }
}

void Display::begin(uint8_t _i2caddr) {
  i2caddr = _i2caddr;
  Wire.begin();

  const uint8_t init_sequence[] = {
    0xAE/*display off*/,
    0xD5/*set display clock divider*/, 0x80,
    0xA8/*set multiplex*/,       DISPLAY_HEIGHT - 1,
    0xD3/*set display offset*/,   0x0,
    0x40/*set start line*/ | 0x0,
    0x8D/*charge pump*/,         0x14,
    0x20/*memory mode*/,         0x00,
    0xA0/*remap segment*/ | 0x1,
    0xC8/*comscan dec*/,
    0xDA/*set comm pins*/,         0x12,
    0x81/*set contrast*/,        0xCF,
    0xD9/*set precharge*/,       0xF1,
    0xDB/*set vcom detect*/,      0x40,
    0xA4/*display all on resume*/,
    0xA6/*normal display*/,
    0x2E/*deactivete scroll*/,
    0xAF/*display on*/
  };
  send_commands(i2caddr, init_sequence, sizeof(init_sequence));
}

void Display::display() {
  const uint8_t command_sequence[] = {
    0x21/*column address*/,   0, DISPLAY_WIDTH - 1,
    0x22/*page address*/,     0, 7
  };
  send_commands(i2caddr, command_sequence, sizeof(command_sequence));

  for (uint16_t i = 0; i < sizeof(buffer); i += 16) {
    Wire.beginTransmission(i2caddr);
    Wire.write(0x40);
    for (uint8_t x = 0; x < 16; x++) {
      Wire.write(buffer[i + x]);
    }
    Wire.endTransmission();
  }
}

void Display::clearDisplay() {
  memset(buffer, 0, sizeof(buffer));
}

void Display::turnOn()
{
  const uint8_t cmd = 0xAF; // Display ON
  send_commands(i2caddr, &cmd, 1);
}

void Display::turnOff()
{
  const uint8_t cmd = 0xAE; // Display OFF
  send_commands(i2caddr, &cmd, 1);
}
